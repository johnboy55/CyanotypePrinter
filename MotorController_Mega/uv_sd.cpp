#include "uv_sd.h"

const char CONFIG_FILE_PATH[] = "/config/uv.cfg";

static String trimBoth(const String &s) {
  int a = 0, b = (int)s.length();
  while (a < b && isspace((unsigned char)s[a])) ++a;
  while (b > a && isspace((unsigned char)s[b - 1])) --b;
  return s.substring(a, b);
}

static bool parseFloatKey(const String &line, const char* key, float &out) {
  String k(key); k += "=";
  if (!line.startsWith(k)) return false;
  out = trimBoth(line.substring(k.length())).toFloat(); return true;
}

static bool parseIntKey(const String &line, const char* key, int &out) {
  String k(key); k += "="; 
  if (!line.startsWith(k)) return false;
  out = trimBoth(line.substring(k.length())).toInt(); return true;
}

static bool parseFloatCSV4(const String &line, const char* key, float out[4]) {
  String k(key); k += "=";
  if (!line.startsWith(k)) return false;
  String rest = line.substring(k.length());
  int idx = 0, start = 0;
  while (idx < 4) {
    int comma = rest.indexOf(',', start);
    String tok = (comma < 0) ? rest.substring(start) : rest.substring(start, comma);
    tok.trim();
    if (!tok.length()) break;
    out[idx++] = tok.toFloat();
    if (comma < 0) break;
    start = comma + 1;
  }
  return (idx == 4);
}

bool loadConfigFromSD(const char* path) {
  File f = SD.open(path, FILE_READ);
  if (!f) return false;
  String line, low;
  while (f.available()) {
    line = f.readStringUntil('\n'); line.replace("\r", "");
    line = trimBoth(line);
    if (!line.length()) continue;
    low = line;
    low.toLowerCase();
    if (low.startsWith("#") || low.startsWith(";")) continue;

    if (low.startsWith("y_band_mm="))      { parseFloatKey(low, "y_band_mm", CFG.yBandAdvanceMM); continue; }
    if (low.startsWith("mm_per_pixel="))   { parseFloatKey(low, "mm_per_pixel", CFG.mmPerPixel); continue; }
    if (low.startsWith("led_spacing_mm=")) { parseFloatKey(low, "led_spacing_mm", CFG.ledSpacingMM); continue; }
    if (low.startsWith("step_period_us=")){ parseIntKey  (low, "step_period_us", CFG.stepPeriodUs); continue; }
    if (low.startsWith("step_pulse_us="))  { parseIntKey  (low, "step_pulse_us",  CFG.stepPulseUs ); continue; }

    if (low.startsWith("led_scales="))     { parseFloatCSV4(low, "led_scales", CFG.ledScale); continue; }
    if (low.startsWith("led1_scale="))     { parseFloatKey (low, "led1_scale", CFG.ledScale[0]); continue; }
    if (low.startsWith("led2_scale="))     { parseFloatKey (low, "led2_scale", CFG.ledScale[1]); continue; }
    if (low.startsWith("led3_scale="))     { parseFloatKey (low, "led3_scale", CFG.ledScale[2]); continue; }
    if (low.startsWith("led4_scale="))     { parseFloatKey (low, "led4_scale", CFG.ledScale[3]); continue; }

    if (low.startsWith("invert_image=")) {
      String k("invert_image="); String v = trimBoth(low.substring(k.length())); v.toLowerCase();
      CFG.invertImage = (v=="1" || v=="true" || v=="yes" || v=="on"); continue;
    }
  }
  f.close();
  return true;
}

void applyConfig() {
  MM_PER_PIXEL   = CFG.mmPerPixel;
  LED_SPACING_MM = CFG.ledSpacingMM;
  STEP_PERIOD_US = CFG.stepPeriodUs;
  STEP_PULSE_US  = CFG.stepPulseUs;
  for (int i = 0; i < 4; i++) LED_SCALE[i] = CFG.ledScale[i];

  STEPS_PER_PIXEL = max(1, (int)(STEPS_PER_MM_X * MM_PER_PIXEL + 0.5f));
  OFFSET_PIXELS   = max(1, (int)(LED_SPACING_MM / MM_PER_PIXEL + 0.5f));
}

void writeDefaultConfigIfMissing(const char* path) {
  if (SD.exists(path)) return;
  File f = SD.open(path, FILE_WRITE);
  if (!f) {
    Serial.println(F("[CFG] Could not create default config"));
    return;
  }
  f.println("# UV Printer config (key=value). Comments start with # or ;");
  f.println("y_band_mm=8.2");
  f.println("mm_per_pixel=2.0");
  f.println("led_spacing_mm=20.0");
  f.println("step_period_us=1000");
  f.println("step_pulse_us=5");
  f.println("led_scales=1.000,1.000,1.000,1.000");
  f.println("invert_image=1");
  f.close();
}

bool saveConfigToSD(const char* path) {
  CFG.mmPerPixel     = MM_PER_PIXEL;
  CFG.ledSpacingMM   = LED_SPACING_MM;
  CFG.stepPeriodUs   = STEP_PERIOD_US;
  CFG.stepPulseUs    = STEP_PULSE_US;
  for (int i = 0; i < 4; i++) CFG.ledScale[i] = LED_SCALE[i];

  File f = SD.open(path, FILE_WRITE);
  if (!f) return false;

  f.println("# UV Printer config (generated by device)");
  f.print  ("y_band_mm=");     f.println(String(CFG.yBandAdvanceMM, 3));
  f.print  ("mm_per_pixel=");  f.println(String(CFG.mmPerPixel, 4));
  f.print  ("led_spacing_mm=");f.println(String(CFG.ledSpacingMM, 3));
  f.print  ("step_period_us=");f.println(CFG.stepPeriodUs);
  f.print  ("step_pulse_us="); f.println(CFG.stepPulseUs);
  f.print("led_scales=");
  f.print(String(LED_SCALE[0],3)); f.print(",");
  f.print(String(LED_SCALE[1],3)); f.print(",");
  f.print(String(LED_SCALE[2],3)); f.print(",");
  f.println(String(LED_SCALE[3],3));
  f.print("invert_image="); f.println(CFG.invertImage ? "1" : "0");
  f.close();
  return true;
}

bool loadCalibrationFile(const String &path) {
  File f = SD.open(path);
  if (!f) return false;
  String all;
  while (f.available()) all += (char)f.read();
  f.close();

  int n = 0, start = 0;
  while (n < 16) {
    int comma = all.indexOf(',', start);
    String tok = (comma < 0) ? all.substring(start) : all.substring(start, comma);
    tok.trim();
    if (tok.length() == 0) break;
    LUT16[n++] = tok.toFloat();
    if (comma < 0) break;
    start = comma + 1;
  }
  return (n == 16);
}